## sound/soc/codecs/tlv320aic326x/Kconfig
```kconfig
#ZTE BSP wgh add for codec  TLV320AIC326X begin
config SND_SOC_TLV320AIC326X
	tristate "TI AIC326x Codec"
#ZTE BSP wgh add for codec  TLV320AIC326X end	
config TLV320AIC326x_U970_VERSION
	int "TLV320AIC326x for U970"
	default 0
```
